## KConfig
```kconfig
menu "Device Drivers"

menu "Storage Controllers"

config INCLUDE_IDE_DRIVER
		bool "Include generic IDE controller driver"
		default y
		help

config INCLUDE_AHCI_DRIVER
		bool "Include generic AHCI controller driver"
		default y
		help

endmenu

menu "Input Controllers and Devices"

config INCLUDE_i8042_DRIVER
		bool "Include i8042 PS/2 controller driver"
		default y
		help

endmenu

endmenu
```

## kernel/Kconfig
```kconfig
menu "General"

source "kernel/consoledemo/Kconfig"

source "kernel/hw/Kconfig"

endmenu

source "kernel/arch/Kconfig"
```

## kernel/arch/Kconfig
```kconfig
menu "Platform"

choice
prompt "Architecture"
	default ARCH_X86

	config ARCH_X86
		bool "x86-64"
	config ARCH_DUMMY
		bool "dummy arch (Dont select)"
endchoice

source "kernel/arch/x86/Kconfig"

endmenu
```

## kernel/arch/x86/Kconfig
```kconfig
config X86_IOAPIC
	bool "Enable I/O APIC Support"
	depends on ARCH_X86
	default y
	help
		"Enable support for I/O APIC. If unchecked, the system will attempt to use the legacy PIC."
```

## kernel/consoledemo/Kconfig
```kconfig
config KCON
    bool "Enable kcon (Deprecated)"
	default n
    help
        "Enables a demo console running in kernel mode. This console provides basic
		commands for testing the kernel and nothing more.
		
		DEPRECATED: Will be removed soon"
```

## kernel/hw/serial/Kconfig
```kconfig
config SERIAL_DEBUGGING
    bool "Serial Debugging"
	default n
    help
        "Enables logging through the serial port. You should leave this unchecked unless you actually
		want to debug the kernel, because the logs may interfere with devices attached to the serial port."
```

## modules/Kconfig
```kconfig
menu "Device Drivers & Other Modules"

# TODO: move this
menu "Busses"

config INCLUDE_PCI_DRIVER
		bool "PCI Support"
		default y
		help
			"Check this if your target system has a PCI bus."

endmenu

source "modules/ahci/Kconfig"

source "modules/ide/Kconfig"

source "modules/i8042/Kconfig"

source "modules/rtc/Kconfig"

source "modules/pit/Kconfig"

endmenu
```

## modules/ahci/Kconfig
```kconfig
config INCLUDE_AHCI_DRIVER
		bool "PCI AHCI Controller Support"
		depends on INCLUDE_PCI_DRIVER
		default y
		help
			"Check this if your target system has a PCI AHCI controller."
```

## modules/i8042/Kconfig
```kconfig
config INCLUDE_i8042_DRIVER
		bool "i8042 PS/2 Support"
		default y
		help
			"Check this if your target system has an i8042 PS/2 controller."
```

## modules/ide/Kconfig
```kconfig
config INCLUDE_IDE_DRIVER
		bool "PCI IDE Controller Support"
		depends on INCLUDE_PCI_DRIVER
		default y
		help
			"Check this if your target system has a PCI IDE controller."
```

## modules/pci/Kconfig
```kconfig
config INCLUDE_PCI_DRIVER
		bool "PCI Support"
		default y
		help
			"Check this if your target system has a PCI bus."
```

## modules/pit/Kconfig
```kconfig
config INCLUDE_PIT_DRIVER
		bool "PIT Timer Support"
		default y
		help
			"Check this if your target system has a PIT installed. This should be checked regardless, though."
```

## modules/rtc/Kconfig
```kconfig
config INCLUDE_RTC_DRIVER
		bool "Real-Time Clock"
		default y
		help
			"Check this if your target system has a standard PC Real-time clock."
```
